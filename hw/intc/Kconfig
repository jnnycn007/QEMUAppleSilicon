## hw/intc/Kconfig
```kconfig
config HEATHROW_PIC
    bool

config I8259
    bool
    select ISA_BUS

config PL190
    bool

config IOAPIC
    bool
    select I8259

config APIC
    bool
    select MSI_NONBROKEN
    select I8259

config ARM_GIC
    bool
    select ARM_GICV3 if TCG
    select ARM_GIC_KVM if KVM
    select MSI_NONBROKEN

config ARM_GICV3
    bool
    depends on ARM_GIC

config ARM_GIC_KVM
    bool
    depends on ARM_GIC && KVM

config ALLWINNER_A10_PIC
    bool

config OMPIC
    bool

config GOLDFISH_PIC
    bool
```

## hw/pci-host/Kconfig
```kconfig
config PAM
    bool

config XEN_IGD_PASSTHROUGH
    bool
    default y
    depends on XEN && PCI_I440FX

config VERSATILE_PCI
    select PCI
    bool

config PCI_SABRE
    select PCI
    bool

config PCI_I440FX
    bool
    select PCI
    select PAM

config PCI_EXPRESS_Q35
    bool
    select PCI_EXPRESS
    select PAM

config PCI_EXPRESS_GENERIC_BRIDGE
    bool
    select PCI_EXPRESS
    imply ACPI_PCI

config PCI_EXPRESS_XILINX
    bool
    select PCI_EXPRESS

config PCI_EXPRESS_DESIGNWARE
    bool
    select PCI_EXPRESS
    select MSI_NONBROKEN

config PCI_BONITO
    select PCI
    select UNIMP
    bool

config REMOTE_PCIHOST
    bool

config SH_PCI
    bool
    select PCI

config PCI_EXPRESS_FSL_IMX8M_PHY
    bool

config GT64120
    bool
    select PCI
    select EMPTY_SLOT
    select I8259
```
